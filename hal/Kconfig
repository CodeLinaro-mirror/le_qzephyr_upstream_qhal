## hal/Kconfig
```kconfig
# Copyright (c) Qualcomm Technologies, Inc. and/or its subsidiaries.
# SPDX-License-Identifier: BSD-3-Clause-Clear


config UART_HAL
	bool "Qualcomm UART HAL"
	default n

config UART_QCC730_LL
	bool "UART QCC730 Low Level for HAL"
	default n
```

## lib/Kconfig
```kconfig
# Copyright (c) Qualcomm Technologies, Inc. and/or its subsidiaries.
# SPDX-License-Identifier: BSD-3-Clause

config QLIB_EARLY_PRINTK
	bool "Qualcomm early printk via UART"
	default n
```

## qat/Kconfig
```kconfig
# Copyright (c) Qualcomm Technologies, Inc. and/or its subsidiaries.
# SPDX-License-Identifier: BSD-3-Clause-Clear

config QAT
	bool "QAT (Qualcomm AT Command) Support"
	depends on CAT && RING_SERVICE
	help
	  Enable QAT module for AT command processing over ring using libcat.
	  This module provides AT command interface for QCC730 communication.

config QAT_SERVICE_STACK_SIZE
	int "QAT service thread stack size"
	depends on QAT
	range 1024 16384
	default 4096 if HTTPC_AT
	default 2048
	help
	  Stack size, in bytes, for the QAT service thread that runs libcat and
	  all AT command handlers.

	  HTTPC AT commands have a materially larger stack footprint than the
	  basic command set, so the default is raised when HTTPC_AT is enabled.
```

## qcrypto/Kconfig
```kconfig
# Copyright (c) Qualcomm Technologies, Inc. and/or its subsidiaries.
# SPDX-License-Identifier: BSD-3-Clause-Clear

config QCRYPTO
	bool "QCOM crypto HAL"
	default n
	select QURT_ABSTRACTION_LAYER
	select QSYSTEM
	select QHW_SUPPORT
```

## qftm/Kconfig
```kconfig
config FTM_MODE
    bool "Enable FTM Mode"
    default n

config FTM_UART_BAUDRATE
    int "FTM UART baud rate"
    default 115200
    help
      The baud rate for FTM UART communication.
```

## qhw_support/Kconfig
```kconfig
# Copyright (c) Qualcomm Technologies, Inc. and/or its subsidiaries.
# SPDX-License-Identifier: BSD-3-Clause-Clear

config QHW_SUPPORT
	bool
	default n
	depends on QURT_ABSTRACTION_LAYER && QSYSTEM && QPOWER
	select CPR_ENABLE

config CPR_ENABLE
    bool "Core power reduction by decreased core voltage"
    default n
```

## qpower/Kconfig
```kconfig
config QPOWER
	bool
	default n
	select QURT_ABSTRACTION_LAYER
	select QSYSTEM
	select QHW_SUPPORT

	# Tick compensation during PM sleep
	select COUNTER_QCC730_AON if PM && COUNTER && TICKLESS_KERNEL
	select COUNTER_QCC730 if PM && COUNTER && TICKLESS_KERNEL
	select CORTEX_M_SYSTICK_RESET_BY_LPM if PM && COUNTER && TICKLESS_KERNEL
	select CORTEX_M_SYSTICK_64BIT_CYCLE_COUNTER if PM && COUNTER && TICKLESS_KERNEL
```

## qring/Kconfig
```kconfig
# Copyright (c) Qualcomm Technologies, Inc. and/or its subsidiaries.
# SPDX-License-Identifier: BSD-3-Clause

config RING_SERVICE
	bool "Ring Service Support"
	default n
	select GPIO
	select SPI
	select SPI_ASYNC
	select SPI_QCC730
	help
	  Enable ring service for efficient data transfer between
	  Host and QCC730 via descriptor-based ring buffers.

if RING_SERVICE

config RING_SERVICE_LOG_LEVEL
	int "Ring Service Log Level"
	default 3
	range 0 4
	help
	  Set log level for ring service.
	  0 = OFF, 1 = ERROR, 2 = WARNING, 3 = INFO, 4 = DEBUG

menu "Ring 0 Configuration (AT Commands)"

config RING0_DESC_COUNT
	int "Ring 0 Descriptor Count"
	default 8
	range 2 256
	help
	  Number of descriptors for Ring 0 (AT Commands).
	  Each descriptor can hold one packet.
	  More descriptors = more buffering but more RAM usage.

config RING0_BUF_SIZE
	int "Ring 0 Buffer Size (bytes)"
	default 1500
	range 64 1500
	help
	  Size of each buffer for Ring 0 (AT Commands).
	  Must be large enough to hold the largest AT command/response.
	  Typical AT commands are < 512 bytes.

endmenu

menu "Ring 1 Configuration (Data)"

config RING1_DESC_COUNT
	int "Ring 1 Descriptor Count"
	default 8
	range 2 256
	help
	  Number of descriptors for Ring 1 (Data).
	  Each descriptor can hold one packet.
	  More descriptors = more buffering but more RAM usage.

config RING1_BUF_SIZE
	int "Ring 1 Buffer Size (bytes)"
	default 1500
	range 64 1500
	help
	  Size of each buffer for Ring 1 (Data).
	  Should match MTU size for network packets (typically 1500).

endmenu

menu "Ring 2 Configuration (Loopback/Test)"

config RING2_DESC_COUNT
	int "Ring 2 Descriptor Count"
	default 8
	range 2 256
	help
	  Number of descriptors for Ring 2 (Loopback/Test).
	  Each descriptor can hold one packet.
	  More descriptors = more buffering but more RAM usage.

config RING2_BUF_SIZE
	int "Ring 2 Buffer Size (bytes)"
	default 1500
	range 64 1500
	help
	  Size of each buffer for Ring 2 (Loopback/Test).
	  Can be adjusted based on test requirements.

endmenu

endif # RING_SERVICE
```

## qsystem/Kconfig
```kconfig
# Copyright (c) Qualcomm Technologies, Inc. and/or its subsidiaries.
# SPDX-License-Identifier: BSD-3-Clause-Clear


config QSYSTEM
	bool
	default n
	depends on QURT_ABSTRACTION_LAYER
```

## qurt/Kconfig
```kconfig
# Copyright (c) Qualcomm Technologies, Inc. and/or its subsidiaries.
# SPDX-License-Identifier: BSD-3-Clause-Clear

# QuRT Abstraction Layer configuration options

menu "QuRT Abstraction Layer"

config QURT_THREAD
	bool
	default n
	prompt "QURT style thread APIs"
	help
	  Enables QuRT style thread APIs

config QURT_ISR
	bool
	default n
	select QURT_THREAD
	select DYNAMIC_INTERRUPTS
	prompt "QuRT Style ISR APIs"
	help
	  QuRT Style ISR APIs

config QURT_ISR_IRQNUM_L1_START
	int
	default 0
	depends on QURT_ISR
	prompt "QuRT L1 irq number start"
	help
	  QuRT L1 irq number start, this number is included in the range

config QURT_ISR_IRQNUM_L1_END
	int
	default 256
	depends on QURT_ISR
	prompt "QuRT L1 irq number end"
	help
	  QuRT L1 irq number end, this number is excluded in the range

config QURT_ISR_IRQNUM_L2_START
	int
	default 0
	depends on QURT_ISR && 2ND_LEVEL_INTERRUPTS
	prompt "QuRT L2 irq number start"
	help
	  QuRT L2 irq number start, this number is included in the range

config QURT_ISR_IRQNUM_L2_END
	int
	default 256
	depends on QURT_ISR && 2ND_LEVEL_INTERRUPTS
	prompt "QuRT L2 irq number end"
	help
	  QuRT L2 irq number end, this number is excluded in the range

config QURT_MUTEX
	bool
	default n
	prompt "QuRT Style mutex APIs"
	help
	  QuRT Style mutex APIs

config QURT_SIGNAL
	bool
	default n
	select EVENTS
	prompt "QuRT Style signal APIs"
	help
	  QuRT Style signal APIs

config QURT_SCLK
	bool
	default n 
	prompt "QuRT Style SCLK APIs"
	help
	  QuRT Style SCLK APIs

config QURT_SEMAPHORE
	bool
	default n
	prompt "QuRT Semaphore APIs"
	help
	  QuRT Style Semaphore APIs

config QURT_MEM
	bool
	default n
	prompt "QURT style memory and cache operations APIs"
	help
	  Enables QuRT style memory and cache operation APIs

config QURT_ABSTRACTION_LAYER
	bool
    default n
	select QURT_SCLK
	select QURT_SIGNAL
	select QURT_MUTEX
	select QURT_THREAD
	select QURT_ISR
	select QURT_SEMAPHORE
	select QURT_MEM
    prompt "QAL"
	help
	  When this option is true, QuRT abstraction layer API's will be included.

endmenu
```

## qwdt/Kconfig
```kconfig
# Copyright (c) 2025 Qualcomm Innovation Center, Inc. All rights reserved.
# SPDX-License-Identifier: BSD-3-Clause-Clear

if WATCHDOG

config WATCH_DOG_BITE_TIME
    int "Watchdog bite time in seconds"
    default 8
    range 1 3600
    help
      Hardware watchdog timeout in seconds. If the watchdog is not fed
      within this time, the system will reset.

      Note: The auto-feed interval is (bite_time - 1) seconds.
      For example, if bite_time is 8 seconds, auto-feed occurs every 7 seconds.

      During power save (IMPS/BMPS), the hardware watchdog continues running.
      If imps time exceeds this value, the system will reset after wakeup.

endif # WATCHDOG
```

## qwifi/Kconfig
```kconfig
# Copyright (c) Qualcomm Technologies, Inc. and/or its subsidiaries.
# SPDX-License-Identifier: BSD-3-Clause-Clear

config QWIFI
	bool "QCOM wifi HAL"
	default n
	select QURT_ABSTRACTION_LAYER
	select MBEDTLS
	select MBEDTLS_CMAC
	select MBEDTLS_CIPHER_AES_ENABLED
	select MBEDTLS_CIPHER_DES_ENABLED
	select MBEDTLS_PKCS5_C
	select MBEDTLS_NIST_KW_C
	select MBEDTLS_MD_C
	select MBEDTLS_SHA1
	select MBEDTLS_CIPHER

	select MBEDTLS_ECP_C
	select MBEDTLS_ECP_DP_SECP256R1_ENABLED
	select MBEDTLS_ENTROPY_C
	select MBEDTLS_HKDF_C

config MAIN_STACK_SIZE
	default 2048 if QWIFI

config DP_RAM_LOCATED
    bool "Locate code of data path into RAM"
    depends on QWIFI && CODE_DATA_RELOCATION
    default y if QWIFI && CODE_DATA_RELOCATION
```

## tests/Kconfig
```kconfig
# Copyright (c) Qualcomm Technologies, Inc. and/or its subsidiaries.
# SPDX-License-Identifier: BSD-3-Clause


config QTEST
	bool "Qualcomm test module enable"
	default n
```
